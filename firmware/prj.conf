## CMakeLists.txt
```
cmake_minimum_required(VERSION 3.20.0)
find_package(Zephyr REQUIRED HINTS $ENV{ZEPHYR_BASE})

project(firmware)

# TFLM uses C++ local statics in the Zephyr samples. Keep that ABI behavior
# explicit when the CNN classifier is selected.
set(NO_THREADSAFE_STATICS $<TARGET_PROPERTY:compiler-cpp,no_threadsafe_statics>)
zephyr_compile_options($<$<COMPILE_LANGUAGE:CXX>:${NO_THREADSAFE_STATICS}>)

target_include_directories(app PRIVATE
    src
    src/ble
    src/modules
    src/classifiers
    src/classifiers/generated
)

set_source_files_properties(src/classifiers/clf_cnn.c PROPERTIES LANGUAGE CXX)

target_sources(app PRIVATE
    src/main.c
    src/benchmark.c
    src/modules/imu.c
)

target_sources_ifdef(CONFIG_BT app PRIVATE src/ble/ble.c)

target_sources_ifdef(CONFIG_CLASSIFIER_NONE app PRIVATE src/classifiers/clf_none.c)
target_sources_ifdef(CONFIG_CLASSIFIER_MLC  app PRIVATE src/classifiers/clf_mlc.c)
target_sources_ifdef(CONFIG_CLASSIFIER_CNN  app PRIVATE src/classifiers/clf_cnn.c)
target_sources_ifdef(CONFIG_CLASSIFIER_HDC  app PRIVATE src/classifiers/clf_hdc.c)
```

## Kconfig
```
mainmenu "Ring microgesture firmware"

choice CLASSIFIER
	prompt "On-device classifier"
	default CLASSIFIER_NONE

config CLASSIFIER_NONE
	bool "None (streaming/data collection)"

config CLASSIFIER_MLC
	bool "Sensor MLC"

config CLASSIFIER_CNN
	bool "TFLM CNN"
	select TENSORFLOW_LITE_MICRO
	help
	  Requires the Zephyr tflite-micro module to be present in the west
	  workspace.

config CLASSIFIER_HDC
	bool "Hyperdimensional computing"

endchoice

config CLASSIFIER_DEBUG_STREAM
	bool "Stream raw IMU samples while classifying"
	depends on !CLASSIFIER_NONE
	default y
	help
	  Keep the raw BLE IMU stream enabled in classifier builds for validation.

config CLASSIFIER_BENCHMARK_MODE
	bool "Headless classifier power/latency benchmark"
	default n
	help
	  Start sensing at boot without BLE transport. CLASSIFIER_NONE provides the
	  sensing/firmware baseline; classifier variants keep their chronological
	  inference cadence and expose cycle counters for debugger/PPK2 runs.

config IMU_STREAM_HZ
	int "IMU stream frequency"
	default 120
	range 60 120
	help
	  Build-time IMU sample rate. Use 120 Hz for the gesture study.

source "Kconfig.zephyr"
```

## prj.conf
```kconfig
# Logger over RTT
CONFIG_LOG=y
CONFIG_LOG_DEFAULT_LEVEL=3
CONFIG_SEGGER_RTT_BUFFER_SIZE_UP=8192
CONFIG_SEGGER_RTT_BUFFER_SIZE_DOWN=512
CONFIG_CONSOLE=y
CONFIG_USE_SEGGER_RTT=y
CONFIG_RTT_CONSOLE=y
CONFIG_LOG_BACKEND_RTT=y
CONFIG_CBPRINTF_FP_SUPPORT=y
CONFIG_HEAP_MEM_POOL_SIZE=0

# Sensors & peripherals
CONFIG_SENSOR=y
CONFIG_I2C=y
CONFIG_GPIO=y
CONFIG_NFCT_PINS_AS_GPIOS=y
CONFIG_SHELL=y
CONFIG_I2C_SHELL=y

CONFIG_NRFX_GPPI=y
CONFIG_NRFX_TIMER22=y

CONFIG_SERIAL=y
CONFIG_UART_CONSOLE=n
CONFIG_UART_INTERRUPT_DRIVEN=n
CONFIG_CBPRINTF_COMPLETE=y

# BLE Core
CONFIG_BT=y
CONFIG_BT_PERIPHERAL=y
CONFIG_BT_DEVICE_NAME="Ring_A"
# CONFIG_BT_DEVICE_APPEARANCE=0
# CONFIG_BT_EXT_ADV=n
CONFIG_BT_LL_SOFTDEVICE=y
CONFIG_BT_HCI=y
CONFIG_BT_OBSERVER=y
CONFIG_BT_BROADCASTER=y
CONFIG_BT_GATT_CLIENT=y
CONFIG_BT_MAX_CONN=1
CONFIG_BT_ID_MAX=1


#GATT_CLIENT needed for requesting ATT_MTU update
CONFIG_BT_GATT_CLIENT=y
#PHY update needed for updating PHY request
CONFIG_BT_USER_PHY_UPDATE=y
#For data length update
# CONFIG_BT_USER_DATA_LEN_UPDATE=y
#This is the maximum data length with Nordic Softdevice controller
CONFIG_BT_CTLR_DATA_LENGTH_MAX=251
#These buffers are needed for the data length max. 
CONFIG_BT_BUF_ACL_TX_SIZE=251
CONFIG_BT_BUF_ACL_RX_SIZE=251
#This is the maximum MTU size with Nordic Softdevice controller
CONFIG_BT_L2CAP_TX_MTU=247

# Increase the number of Bluetooth L2CAP TX buffers
CONFIG_BT_L2CAP_TX_BUF_COUNT=20

# Increase the max number of connections TX buffers
CONFIG_BT_CONN_TX_MAX=20
```

## overlay-benchmark.conf
```kconfig
# Combine with exactly one classifier overlay using EXTRA_CONF_FILE.
CONFIG_CLASSIFIER_BENCHMARK_MODE=y
CONFIG_CLASSIFIER_DEBUG_STREAM=n

# Exclude the complete BLE host/controller and transport implementation from
# resource benchmarks. All four variants measure the local sensing/classifier
# deployment path with no radio stack linked into the image.
CONFIG_BT=n

# Eliminate measurement contamination from logs, shell, and console traffic.
CONFIG_LOG=n
CONFIG_SHELL=n
CONFIG_I2C_SHELL=n
CONFIG_CONSOLE=n
CONFIG_RTT_CONSOLE=n
CONFIG_LOG_BACKEND_RTT=n

# Tickless idle lets Zephyr enter the board-supported System ON idle state
# whenever all inference threads block. CONFIG_PM is not supported by this
# nRF54L15 board configuration and must not be forced here.
CONFIG_TICKLESS_KERNEL=y
```

## overlay-cnn.conf
```kconfig
CONFIG_CLASSIFIER_CNN=y
CONFIG_CPP=y
CONFIG_STD_CPP17=y
CONFIG_TENSORFLOW_LITE_MICRO=y
CONFIG_TENSORFLOW_LITE_MICRO_CMSIS_NN_KERNELS=y
```

## overlay-hdc.conf
```kconfig
CONFIG_CLASSIFIER_HDC=y
```

## overlay-mlc.conf
```kconfig
CONFIG_CLASSIFIER_MLC=y
```

## overlay-none.conf
```kconfig
CONFIG_CLASSIFIER_NONE=y
```

## src/main.c
```c
#include <errno.h>
#include <stdint.h>
#include <string.h>

#include <zephyr/kernel.h>
#include <zephyr/logging/log.h>
#include <zephyr/sys/util.h>

#include "ble/ble.h"
#include "benchmark.h"
#include "classifiers/classifier.h"
#include "modules/imu.h"

LOG_MODULE_REGISTER(app, LOG_LEVEL_INF);

#define EVENT_CLASSIFIER_SAMPLES BIT(2)
#define CONTROL_EVENTS (EVENT_START_STREAMING | EVENT_ENTER_LOW_POWER | EVENT_CLASSIFIER_SAMPLES)

/* These application-state objects are shared with BLE in normal builds, but
 * must remain available when CONFIG_BT=n in a headless benchmark build. */
K_EVENT_DEFINE(sys_events);
volatile bool is_streaming;

#if !defined(CONFIG_CLASSIFIER_NONE) && !defined(CONFIG_CLASSIFIER_MLC)
#define CLASSIFIER_HOP_SAMPLES 64U
#define CLASSIFIER_QUEUE_LEN 128U

K_MSGQ_DEFINE(classifier_sample_msgq,
	      sizeof(struct bt_app_imu_sample),
	      CLASSIFIER_QUEUE_LEN,
	      4);

static int16_t classifier_ring[CLF_WINDOW_SAMPLES][CLF_CHANNELS];
static int16_t classifier_window[CLF_WINDOW_SAMPLES][CLF_CHANNELS];
static uint16_t ring_write_index;
static uint16_t ring_count;
static uint16_t hop_count;
static bool sample_id_valid;
static uint16_t last_sample_id16;
static uint32_t unwrapped_sample_id;
static uint32_t window_end_sample_id;

static void classifier_reset(void)
{
	k_msgq_purge(&classifier_sample_msgq);
	memset(classifier_ring, 0, sizeof(classifier_ring));
	memset(classifier_window, 0, sizeof(classifier_window));
	ring_write_index = 0U;
	ring_count = 0U;
	hop_count = 0U;
	sample_id_valid = false;
	last_sample_id16 = 0U;
	unwrapped_sample_id = 0U;
	window_end_sample_id = 0U;
}

static uint32_t unwrap_sample_id(uint16_t sample_id)
{
	if (!sample_id_valid) {
		sample_id_valid = true;
		last_sample_id16 = sample_id;
		unwrapped_sample_id = sample_id;
		return unwrapped_sample_id;
	}

	unwrapped_sample_id += (uint16_t)(sample_id - last_sample_id16);
	last_sample_id16 = sample_id;

	return unwrapped_sample_id;
}

static void classifier_sample_callback(const struct bt_app_imu_sample *samples,
				       size_t sample_count)
{
	static uint32_t dropped_samples;

	for (size_t i = 0U; i < sample_count; i++) {
		int ret = k_msgq_put(&classifier_sample_msgq, &samples[i], K_NO_WAIT);

		if (ret != 0) {
			dropped_samples++;
			if ((dropped_samples % 32U) == 1U) {
				LOG_WRN("Dropped classifier sample (total %u)", dropped_samples);
			}
		}
	}
	if (sample_count > 0U) {
		k_event_post(&sys_events, EVENT_CLASSIFIER_SAMPLES);
	}
}

static void classifier_copy_window(void)
{
	uint16_t oldest = ring_write_index;

	for (uint16_t i = 0U; i < CLF_WINDOW_SAMPLES; i++) {
		uint16_t src = (oldest + i) % CLF_WINDOW_SAMPLES;

		memcpy(classifier_window[i], classifier_ring[src], sizeof(classifier_window[i]));
	}
}

static void classifier_process_sample(const struct bt_app_imu_sample *sample)
{
	uint32_t sample_id = unwrap_sample_id(sample->sample_id);
	int decision;

	classifier_ring[ring_write_index][0] = sample->accel_raw[0];
	classifier_ring[ring_write_index][1] = sample->accel_raw[1];
	classifier_ring[ring_write_index][2] = sample->accel_raw[2];
	classifier_ring[ring_write_index][3] = sample->gyro_raw[0];
	classifier_ring[ring_write_index][4] = sample->gyro_raw[1];
	classifier_ring[ring_write_index][5] = sample->gyro_raw[2];

	ring_write_index = (ring_write_index + 1U) % CLF_WINDOW_SAMPLES;
	if (ring_count < CLF_WINDOW_SAMPLES) {
		ring_count++;
	}

	hop_count++;
	window_end_sample_id = sample_id;

	if (ring_count < CLF_WINDOW_SAMPLES || hop_count < CLASSIFIER_HOP_SAMPLES) {
		return;
	}

	hop_count = 0U;
	classifier_copy_window();
	uint32_t cycle_start = k_cycle_get_32();
	decision = clf_process_window(classifier_window, CLF_WINDOW_SAMPLES);
	classifier_benchmark_record(k_cycle_get_32() - cycle_start);

#if IS_ENABLED(CONFIG_BT)
	if (decision >= 0 && decision < CLF_CLASS_COUNT) {
		bt_app_send_classification(IS_ENABLED(CONFIG_CLASSIFIER_CNN) ?
					   BT_APP_CLASSIFIER_CNN : BT_APP_CLASSIFIER_HDC,
					   (uint8_t)decision,
					   (uint8_t)decision,
					   clf_last_score(),
					   window_end_sample_id);
	}
#endif
}

static void classifier_drain_samples(void)
{
	struct bt_app_imu_sample sample;

	while (k_msgq_get(&classifier_sample_msgq, &sample, K_NO_WAIT) == 0) {
		classifier_process_sample(&sample);
	}
}
#else
static void classifier_reset(void)
{
}
#endif

static void handle_control_events(uint32_t events)
{
	LOG_INF("handle_control_events: events=0x%08x", events);

	if ((events & EVENT_ENTER_LOW_POWER) != 0U) {
		LOG_INF("handle_control_events: EVENT_ENTER_LOW_POWER");
		imu_stop_streaming();
#if IS_ENABLED(CONFIG_BT)
		bt_app_mark_stream_stopped();
#endif
	}

	if ((events & EVENT_START_STREAMING) != 0U) {
		int ret;

		LOG_INF("handle_control_events: EVENT_START_STREAMING");
		classifier_reset();
		ret = imu_start_streaming();
		LOG_INF("handle_control_events: imu_start_streaming() -> %d", ret);
		if (ret != 0) {
			LOG_ERR("Failed to start IMU stream (err %d)", ret);
#if IS_ENABLED(CONFIG_BT)
			bt_app_mark_stream_stopped();
#endif
		}
	}
}

int main(void)
{
	int ret;

#if IS_ENABLED(CONFIG_BT)
	if (!IS_ENABLED(CONFIG_CLASSIFIER_BENCHMARK_MODE)) {
		ret = ble_init();
		if (ret != 0) {
			return ret;
		}
	}
#endif

	ret = imu_init();
	if (ret != 0) {
		return ret;
	}

	ret = clf_init();
	if (ret != 0) {
		LOG_WRN("Classifier %s init returned %d", clf_name(), ret);
	}

	#if !defined(CONFIG_CLASSIFIER_NONE) && !defined(CONFIG_CLASSIFIER_MLC)
		imu_set_sample_callback(classifier_sample_callback);
	#endif

	if (IS_ENABLED(CONFIG_CLASSIFIER_BENCHMARK_MODE)) {
		classifier_reset();
		ret = imu_start_streaming();
		if (ret != 0) {
			return ret;
		}
		is_streaming = true;
	}

	LOG_INF("Firmware ready: classifier=%s", clf_name());

	int64_t main_heartbeat_last_ms = k_uptime_get();

	while (1) {
		uint32_t events = k_event_wait(
			&sys_events,
			CONTROL_EVENTS,
			false,
			IS_ENABLED(CONFIG_CLASSIFIER_BENCHMARK_MODE) ? K_FOREVER : K_NO_WAIT);

		if (events != 0U) {
			k_event_clear(&sys_events, events);
			handle_control_events(events);
		}

#if IS_ENABLED(CONFIG_BT)
		if (!IS_ENABLED(CONFIG_CLASSIFIER_BENCHMARK_MODE)) {
			(void)bt_app_stream_should_continue();
		}
#endif

		int64_t now_ms = k_uptime_get();

		if ((now_ms - main_heartbeat_last_ms) >= 2000) {
			main_heartbeat_last_ms = now_ms;
			LOG_INF("main loop alive: is_streaming=%d last_events=0x%08x",
				(int)is_streaming, events);
		}

#if !defined(CONFIG_CLASSIFIER_NONE) && !defined(CONFIG_CLASSIFIER_MLC)
		classifier_drain_samples();
#endif
		if (!IS_ENABLED(CONFIG_CLASSIFIER_BENCHMARK_MODE)) {
			k_msleep(20);
		}
	}
}
```

## src/benchmark.c
```c
#include <limits.h>
#include <stdint.h>

#include <zephyr/sys_clock.h>

#include "benchmark.h"

struct classifier_benchmark_stats g_classifier_benchmark_stats = {
	.min_cycles = UINT32_MAX,
	.cycles_per_second = CONFIG_SYS_CLOCK_HW_CYCLES_PER_SEC,
};

void classifier_benchmark_record(uint32_t cycles)
{
	g_classifier_benchmark_stats.inference_count++;
	g_classifier_benchmark_stats.total_cycles += cycles;
	if (cycles < g_classifier_benchmark_stats.min_cycles) {
		g_classifier_benchmark_stats.min_cycles = cycles;
	}
	if (cycles > g_classifier_benchmark_stats.max_cycles) {
		g_classifier_benchmark_stats.max_cycles = cycles;
	}
}
```

## src/benchmark.h
```c
#ifndef RING_BENCHMARK_H
#define RING_BENCHMARK_H

#include <stdint.h>

struct classifier_benchmark_stats {
	volatile uint32_t inference_count;
	volatile uint64_t total_cycles;
	volatile uint32_t min_cycles;
	volatile uint32_t max_cycles;
	uint32_t cycles_per_second;
};

extern struct classifier_benchmark_stats g_classifier_benchmark_stats;

void classifier_benchmark_record(uint32_t cycles);

#endif
```
